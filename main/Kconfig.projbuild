## main/Kconfig.projbuild
```kconfig
menu "LG Whisen IR AC"

config LG_IR_TX_GPIO
    int "IR transmitter GPIO"
    default 4
    help
        GPIO connected to the IR LED driver transistor. GPIO4 is a practical
        default for many ESP32-C3 Super Mini breakout boards.

config LG_IR_CARRIER_HZ
    int "IR carrier frequency"
    default 38000

config LG_IR_DEFAULT_TEMP_C
    int "Default cooling setpoint in Celsius"
    default 24
    range 18 30

config LG_IR_DEFAULT_FAN
    int "Default fan mode"
    default 5
    range 0 5
    help
        0 auto, 1 low, 2 medium, 3 high, 4 powerful, 5 natural.

endmenu
```

## sdkconfig.defaults
```kconfig
CONFIG_IDF_TARGET="esp32c3"
CONFIG_PARTITION_TABLE_CUSTOM=y
CONFIG_PARTITION_TABLE_CUSTOM_FILENAME="partitions.csv"
CONFIG_ESPTOOLPY_FLASHSIZE_4MB=y
CONFIG_ESPTOOLPY_FLASHSIZE="4MB"
CONFIG_BT_ENABLED=y
CONFIG_BT_BLE_ENABLED=y
CONFIG_BT_BLUEDROID_ENABLED=y
CONFIG_BT_BLE_42_FEATURES_SUPPORTED=y
CONFIG_MBEDTLS_HKDF_C=y
CONFIG_ENABLE_CHIP_SHELL=y
CONFIG_ESP_CONSOLE_USB_SERIAL_JTAG=y
CONFIG_LOG_DEFAULT_LEVEL_INFO=y
CONFIG_ENABLE_COMMISSIONABLE_DEVICE_TYPE=y
CONFIG_DEVICE_TYPE=769
CONFIG_ESP_PHY_MAX_WIFI_TX_POWER=10

# Keep the Matter data model small enough for ESP32-C3 and avoid compiling
# unrelated generated clusters.
# CONFIG_SUPPORT_ACCOUNT_LOGIN_CLUSTER is not set
# CONFIG_SUPPORT_ACTIONS_CLUSTER is not set
# CONFIG_SUPPORT_ACTIVATED_CARBON_FILTER_MONITORING_CLUSTER is not set
# CONFIG_SUPPORT_AIR_QUALITY_CLUSTER is not set
# CONFIG_SUPPORT_APPLICATION_BASIC_CLUSTER is not set
# CONFIG_SUPPORT_APPLICATION_LAUNCHER_CLUSTER is not set
# CONFIG_SUPPORT_AUDIO_OUTPUT_CLUSTER is not set
# CONFIG_SUPPORT_BOOLEAN_STATE_CONFIGURATION_CLUSTER is not set
# CONFIG_SUPPORT_BRIDGED_DEVICE_BASIC_INFORMATION_CLUSTER is not set
# CONFIG_SUPPORT_CAMERA_AV_SETTINGS_USER_LEVEL_MANAGEMENT_CLUSTER is not set
# CONFIG_SUPPORT_CAMERA_AV_STREAM_MANAGEMENT_CLUSTER is not set
# CONFIG_SUPPORT_CARBON_DIOXIDE_CONCENTRATION_MEASUREMENT_CLUSTER is not set
# CONFIG_SUPPORT_CARBON_MONOXIDE_CONCENTRATION_MEASUREMENT_CLUSTER is not set
# CONFIG_SUPPORT_CHANNEL_CLUSTER is not set
# CONFIG_SUPPORT_CHIME_CLUSTER is not set
# CONFIG_SUPPORT_CLOSURE_CONTROL_CLUSTER is not set
# CONFIG_SUPPORT_CLOSURE_DIMENSION_CLUSTER is not set
# CONFIG_SUPPORT_COLOR_CONTROL_CLUSTER is not set
# CONFIG_SUPPORT_COMMISSIONER_CONTROL_CLUSTER is not set
# CONFIG_SUPPORT_COMMODITY_PRICE_CLUSTER is not set
# CONFIG_SUPPORT_CONTENT_LAUNCHER_CLUSTER is not set
# CONFIG_SUPPORT_CONTENT_CONTROL_CLUSTER is not set
# CONFIG_SUPPORT_CONTENT_APP_OBSERVER_CLUSTER is not set
# CONFIG_SUPPORT_DEVICE_ENERGY_MANAGEMENT_CLUSTER is not set
# CONFIG_SUPPORT_DEVICE_ENERGY_MANAGEMENT_MODE_CLUSTER is not set
# CONFIG_SUPPORT_DIAGNOSTIC_LOGS_CLUSTER is not set
# CONFIG_SUPPORT_DISHWASHER_ALARM_CLUSTER is not set
# CONFIG_SUPPORT_DISHWASHER_MODE_CLUSTER is not set
# CONFIG_SUPPORT_ELECTRICAL_GRID_CONDITIONS_CLUSTER is not set
# CONFIG_SUPPORT_METER_IDENTIFICATION_CLUSTER is not set
# CONFIG_SUPPORT_MICROWAVE_OVEN_MODE_CLUSTER is not set
# CONFIG_SUPPORT_DOOR_LOCK_CLUSTER is not set
# CONFIG_SUPPORT_ECOSYSTEM_INFORMATION_CLUSTER is not set
# CONFIG_SUPPORT_ELECTRICAL_ENERGY_MEASUREMENT_CLUSTER is not set
# CONFIG_SUPPORT_ELECTRICAL_POWER_MEASUREMENT_CLUSTER is not set
# CONFIG_SUPPORT_ENERGY_EVSE_CLUSTER is not set
# CONFIG_SUPPORT_ENERGY_EVSE_MODE_CLUSTER is not set
# CONFIG_SUPPORT_ETHERNET_NETWORK_DIAGNOSTICS_CLUSTER is not set
# CONFIG_SUPPORT_ENERGY_PREFERENCE_CLUSTER is not set
# CONFIG_SUPPORT_FAULT_INJECTION_CLUSTER is not set
# CONFIG_SUPPORT_FIXED_LABEL_CLUSTER is not set
# CONFIG_SUPPORT_FORMALDEHYDE_CONCENTRATION_MEASUREMENT_CLUSTER is not set
# CONFIG_SUPPORT_HEPA_FILTER_MONITORING_CLUSTER is not set
# CONFIG_SUPPORT_ICD_MANAGEMENT_CLUSTER is not set
# CONFIG_SUPPORT_JOINT_FABRIC_DATASTORE_CLUSTER is not set
# CONFIG_SUPPORT_JOINT_FABRIC_ADMINISTRATOR_CLUSTER is not set
# CONFIG_SUPPORT_KEYPAD_INPUT_CLUSTER is not set
# CONFIG_SUPPORT_LAUNDRY_WASHER_MODE_CLUSTER is not set
# CONFIG_SUPPORT_LOCALIZATION_CONFIGURATION_CLUSTER is not set
# CONFIG_SUPPORT_LOW_POWER_CLUSTER is not set
# CONFIG_SUPPORT_MEDIA_INPUT_CLUSTER is not set
# CONFIG_SUPPORT_MEDIA_PLAYBACK_CLUSTER is not set
# CONFIG_SUPPORT_MICROWAVE_OVEN_CONTROL_CLUSTER is not set
# CONFIG_SUPPORT_MESSAGES_CLUSTER is not set
# CONFIG_SUPPORT_MODE_SELECT_CLUSTER is not set
# CONFIG_SUPPORT_NITROGEN_DIOXIDE_CONCENTRATION_MEASUREMENT_CLUSTER is not set
# CONFIG_SUPPORT_SAMPLE_MEI_CLUSTER is not set
# CONFIG_SUPPORT_OCCUPANCY_SENSING_CLUSTER is not set
# CONFIG_SUPPORT_POWER_TOPOLOGY_CLUSTER is not set
# CONFIG_SUPPORT_OPERATIONAL_STATE_CLUSTER is not set
# CONFIG_SUPPORT_OPERATIONAL_STATE_OVEN_CLUSTER is not set
# CONFIG_SUPPORT_OPERATIONAL_STATE_RVC_CLUSTER is not set
# CONFIG_SUPPORT_OTA_SOFTWARE_UPDATE_REQUESTOR_CLUSTER is not set
# CONFIG_SUPPORT_OVEN_MODE_CLUSTER is not set
# CONFIG_SUPPORT_OZONE_CONCENTRATION_MEASUREMENT_CLUSTER is not set
# CONFIG_SUPPORT_PM10_CONCENTRATION_MEASUREMENT_CLUSTER is not set
# CONFIG_SUPPORT_PM1_CONCENTRATION_MEASUREMENT_CLUSTER is not set
# CONFIG_SUPPORT_PM2_5_CONCENTRATION_MEASUREMENT_CLUSTER is not set
# CONFIG_SUPPORT_POWER_SOURCE_CONFIGURATION_CLUSTER is not set
# CONFIG_SUPPORT_PUMP_CONFIGURATION_AND_CONTROL_CLUSTER is not set
# CONFIG_SUPPORT_RADON_CONCENTRATION_MEASUREMENT_CLUSTER is not set
# CONFIG_SUPPORT_REFRIGERATOR_ALARM_CLUSTER is not set
# CONFIG_SUPPORT_REFRIGERATOR_AND_TEMPERATURE_CONTROLLED_CABINET_MODE_CLUSTER is not set
# CONFIG_SUPPORT_RVC_CLEAN_MODE_CLUSTER is not set
# CONFIG_SUPPORT_RVC_RUN_MODE_CLUSTER is not set
# CONFIG_SUPPORT_SERVICE_AREA_CLUSTER is not set
# CONFIG_SUPPORT_SMOKE_CO_ALARM_CLUSTER is not set
# CONFIG_SUPPORT_SOFTWARE_DIAGNOSTICS_CLUSTER is not set
# CONFIG_SUPPORT_SOIL_MEASUREMENT_CLUSTER is not set
# CONFIG_SUPPORT_SWITCH_CLUSTER is not set
# CONFIG_SUPPORT_TARGET_NAVIGATOR_CLUSTER is not set
# CONFIG_SUPPORT_TEMPERATURE_CONTROL_CLUSTER is not set
# CONFIG_SUPPORT_THREAD_BORDER_ROUTER_MANAGEMENT_CLUSTER is not set
# CONFIG_SUPPORT_THREAD_NETWORK_DIAGNOSTICS_CLUSTER is not set
# CONFIG_SUPPORT_THREAD_NETWORK_DIRECTORY_CLUSTER is not set
# CONFIG_SUPPORT_TIME_FORMAT_LOCALIZATION_CLUSTER is not set
# CONFIG_SUPPORT_TIME_SYNCHRONIZATION_CLUSTER is not set
# CONFIG_SUPPORT_TIMER_CLUSTER is not set
# CONFIG_SUPPORT_TVOC_CONCENTRATION_MEASUREMENT_CLUSTER is not set
# CONFIG_SUPPORT_UNIT_LOCALIZATION_CLUSTER is not set
# CONFIG_SUPPORT_UNIT_TESTING_CLUSTER is not set
# CONFIG_SUPPORT_USER_LABEL_CLUSTER is not set
# CONFIG_SUPPORT_VALVE_CONFIGURATION_AND_CONTROL_CLUSTER is not set
# CONFIG_SUPPORT_WAKE_ON_LAN_CLUSTER is not set
# CONFIG_SUPPORT_LAUNDRY_WASHER_CONTROLS_CLUSTER is not set
# CONFIG_SUPPORT_LAUNDRY_DRYER_CONTROLS_CLUSTER is not set
# CONFIG_SUPPORT_WEB_RTC_TRANSPORT_PROVIDER_CLUSTER is not set
# CONFIG_SUPPORT_WEB_RTC_TRANSPORT_REQUESTOR_CLUSTER is not set
# CONFIG_SUPPORT_WIFI_NETWORK_DIAGNOSTICS_CLUSTER is not set
# CONFIG_SUPPORT_WIFI_NETWORK_MANAGEMENT_CLUSTER is not set
# CONFIG_SUPPORT_WINDOW_COVERING_CLUSTER is not set
# CONFIG_SUPPORT_WATER_HEATER_MANAGEMENT_CLUSTER is not set
# CONFIG_SUPPORT_WATER_HEATER_MODE_CLUSTER is not set
```
